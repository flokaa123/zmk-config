## config/boards/shields/dactylFloLa/Kconfig.shield
```kconfig
config SHIELD_DACTYLFLOLA_L
    def_bool $(shields_list_contains, dactylFloLa_l)

config SHIELD_DACTYLFLOLA_R
    def_bool $(shields_list_contains, dactylFloLa_r)
```
